## esp32-ssd1315-dashboard/main/Kconfig.projbuild
```kconfig
menu "Sitting dashboard"

    orsource "$IDF_PATH/examples/common_components/env_caps/$IDF_TARGET/Kconfig.env_caps"

    menu "Panel (SSD1315 over I2C)"

        config DASH_I2C_SDA
            int "SDA GPIO"
            range ENV_GPIO_RANGE_MIN ENV_GPIO_OUT_RANGE_MAX
            default 1
            help
                GPIO wired to the panel's SDA pin. The internal pull-up is enabled.

        config DASH_I2C_SCL
            int "SCL GPIO"
            range ENV_GPIO_RANGE_MIN ENV_GPIO_OUT_RANGE_MAX
            default 0
            help
                GPIO wired to the panel's SCL pin. The internal pull-up is enabled.

        config DASH_I2C_FREQ_HZ
            int "I2C frequency (Hz)"
            range 10000 1000000
            default 400000
            help
                SCL clock. SSD1306/SSD1315 modules work at 400 kHz; lower it if
                the wiring is long.

        config DASH_I2C_ADDRESS
            hex "Panel I2C address"
            range 0x00 0x7F
            default 0x3C
            help
                7-bit I2C address of the panel, usually 0x3C or 0x3D.

    endmenu

    menu "Buttons"

        config DASH_BTN_REFRESH_GPIO
            int "Refresh button GPIO"
            range ENV_GPIO_RANGE_MIN ENV_GPIO_IN_RANGE_MAX
            default 2
            help
                Momentary button to ground. Press twice within the confirm
                window to fetch the status right away.

        config DASH_BTN_SPARE1_GPIO
            int "Spare button 1 GPIO"
            range ENV_GPIO_RANGE_MIN ENV_GPIO_IN_RANGE_MAX
            default 3
            help
                Momentary button to ground. Reserved, no function yet.

        config DASH_BTN_SPARE2_GPIO
            int "Spare button 2 GPIO"
            range ENV_GPIO_RANGE_MIN ENV_GPIO_IN_RANGE_MAX
            default 4
            help
                Momentary button to ground. Reserved, no function yet.
                GPIO 4 is a strapping pin: don't hold the button during reset.

        config DASH_BTN_SPARE3_GPIO
            int "Spare button 3 GPIO"
            range ENV_GPIO_RANGE_MIN ENV_GPIO_IN_RANGE_MAX
            default 5
            help
                Momentary button to ground. Reserved, no function yet.
                GPIO 5 is a strapping pin: don't hold the button during reset.

        config DASH_CONFIRM_MS
            int "Refresh confirm window (ms)"
            range 200 5000
            default 1000
            help
                After the first press of the refresh button, "refresh?" is shown
                for this long. A second press within the window fetches now.

    endmenu

    menu "Wi-Fi"

        config DASH_WIFI_SSID
            string "SSID"
            default ""
            help
                Network to join as a station. Empty shows "no config" on the panel.

        config DASH_WIFI_PASSWORD
            string "Passphrase"
            default ""
            help
                WPA2/WPA3 passphrase. Leave empty for an open network. Stored in
                sdkconfig, which git ignores.

    endmenu

    menu "Sitting tracker API"

        choice DASH_API_SCHEME
            prompt "URL scheme"
            default DASH_API_SCHEME_HTTPS
            help
                https verifies the server against the bundled certificate store;
                http is for a local dev server.

            config DASH_API_SCHEME_HTTPS
                bool "https"
            config DASH_API_SCHEME_HTTP
                bool "http"
        endchoice

        config DASH_API_HOST
            string "Host"
            default "sitting.lviv.social"
            help
                Hostname or IP address of the sitting tracker.

        config DASH_API_PORT
            int "Port"
            range 1 65535
            default 443
            help
                TCP port; 443 for the production https server.

        config DASH_API_TOKEN
            string "API token"
            default ""
            help
                Bearer token sent with every request. Obtain one with
                POST /api/v1/login (see the README). Empty shows "no config" on
                the panel. Stored in sdkconfig, which git ignores.

        config DASH_REFRESH_SECONDS
            int "Refresh interval (s)"
            range 5 3600
            default 30
            help
                How often the status is fetched while Wi-Fi is up.

    endmenu

endmenu
```
